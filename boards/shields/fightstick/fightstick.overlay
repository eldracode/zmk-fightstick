/ {
    // Kscan driver for our direct-wired buttons
    kscan0: kscan {
        compatible = "zmk,kscan-gpio-direct";
        label = "FIGHTSTICK";
        
        // The format is <&gpioPORT PIN_NUMBER (GPIO_ACTIVE_LOW | GPIO_PULL_UP)>
        // Most pins are on &gpio0. Some are on &gpio1.
        input-gpios
            = <&gpio0 2 (GPIO_ACTIVE_LOW | GPIO_PULL_UP)>   // Your Label: 002 -> Up
            , <&gpio0 6 (GPIO_ACTIVE_LOW | GPIO_PULL_UP)>   // Your Label: 006 -> Down
            , <&gpio0 8 (GPIO_ACTIVE_LOW | GPIO_PULL_UP)>   // Your Label: 008 -> Left
            , <&gpio0 10 (GPIO_ACTIVE_LOW | GPIO_PULL_UP)>  // Your Label: 010 -> Right
            , <&gpio0 17 (GPIO_ACTIVE_LOW | GPIO_PULL_UP)>  // Your Label: 17  -> B1
            , <&gpio0 20 (GPIO_ACTIVE_LOW | GPIO_PULL_UP)>  // Your Label: 20  -> B2
            , <&gpio0 22 (GPIO_ACTIVE_LOW | GPIO_PULL_UP)>  // Your Label: 22  -> B3
            , <&gpio0 24 (GPIO_ACTIVE_LOW | GPIO_PULL_UP)>  // Your Label: 24  -> B4
            , <&gpio0 29 (GPIO_ACTIVE_LOW | GPIO_PULL_UP)>  // Your Label: 029 -> B5
            , <&gpio0 31 (GPIO_ACTIVE_LOW | GPIO_PULL_UP)>  // Your Label: 031 -> B6
            , <&gpio0 11 (GPIO_ACTIVE_LOW | GPIO_PULL_UP)>  // Your Label: 011 -> Start
            , <&gpio1 11 (GPIO_ACTIVE_LOW | GPIO_PULL_UP)>  // Your Label: 111 -> Select
            , <&gpio1 13 (GPIO_ACTIVE_LOW | GPIO_PULL_UP)>  // Your Label: 113 -> Home
            ;
    };
};