## boards/shields/fightstick/Kconfig.defconfig
```kconfig
# Copyright (c) 2022 The ZMK Contributors
# SPDX-License-Identifier: MIT

if SHIELD_FIGHSTICK

config ZMK_KEYBOARD_NAME
    default "FIGHTSTICK"

endif
```
